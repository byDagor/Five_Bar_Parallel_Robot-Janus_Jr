//Include libraries necessary for the project
#include <SimpleFOCSVM.h>     //Library to control the BLDC Motors: https://github.com/askuric/Arduino-FOC
                              //Needs specific modifications to run on the ESP32
                              //The Version of the library that will work for sure with this project is on this GitHub repository.
#include "driver/mcpwm.h"
#include "soc/mcpwm_reg.h"
#include "soc/mcpwm_struct.h"
#include <WiFi.h>
#include <ESP32WebServer.h>
#include <WebSocketsServer.h>

// MCPWM Pins (PWM pins)
#define GPIO_PWM0A_OUT 25   //Set GPIO 25 as PWM0A
#define GPIO_PWM0B_OUT 16   //Set GPIO 16 as PWM0B
#define GPIO_PWM1A_OUT 26   //Set GPIO 26 as PWM1A
#define GPIO_PWM1B_OUT 17   //Set GPIO 17 as PWM1B
#define GPIO_PWM2A_OUT 27   //Set GPIO 27 as PWM2A
#define GPIO_PWM2B_OUT 18   //Set GPIO 18 as PWM2B

// Define encoder(s) interrupt pins. It has to be a quadrature incremental encoder.
// Encoder for Motor A
#define channelA 38
#define channelB 39
// Encoder for Motor B
#define channelC 36
#define channelD 37

// Write wifi network and password
const char* ssid_wifi = "Write here your local network name";
const char* password_wifi = "Write here your password"; 
// Static variables used in WebSocketEvent_vd() function to manage data recieved from the webpage
static char *dataJoy;
static int16_t coordenadas[7];
static int16_t i;

//Variables used in the handleData() function to properly detect when the buttons are pressed
int posX_joy = 200;
int posY_joy = 200;
byte save, play, stap, reset, demoM, demoC; 

//Web page developed in HTML and JS codified in HEX
static const char INDEX_HTML[] PROGMEM ={0x1f,0x8b,0x08,0x08,0x07,0xf1,0xae,0x5e,0x00,0xff,0x69,0x6e,0x64,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0x00,0x00}; 

//Creates web server on port 80 and creates a web socket server
ESP32WebServer server (80); 
WebSocketsServer webSocket = WebSocketsServer(8001);

//  BLDCMotor( int phA, int phB, int phC, int pp, int en)
//  - phA, phB, phC - motor A,B,C phase pwm pins
//  - pp            - pole pair number
//  - enable pin    - (optional input)
BLDCMotor motor = BLDCMotor(25, 26, 27, 7);
BLDCMotor motorB = BLDCMotor(16, 17, 18, 7);
//  Encoder(int encA, int encB , int cpr, int index)
//  - encA, encB    - encoder A and B pins
//  - ppr           - impulses per rotation  (cpr=ppr*4)
//  - index pin     - (optional input) 
Encoder encoder = Encoder(channelA, channelB, 2048);    //AMT103 ppr = 2048, so cpr = 8192
Encoder encoderB = Encoder(channelC, channelD, 2048);

// Interrupt rutine intialisation
// channel A and B callbacks
void doA1(){encoder.handleA();}
void doB1(){encoder.handleB();}

void doA2(){encoderB.handleA();}
void doB2(){encoderB.handleB();}

//Time managing variables
float runTime, prevT = 0, timeDif, stateT;
int sp = 0, limit, timeInterval = 12000;
byte machineState = 0;

//System Gains and parameters
float ki = 1.0;      //Propotional gain for the PI velocity controller
float ti = 5.0;      //Integral gain for the PI velocity controller
float kp = 8.0;      //Proportional gain for the P position controller
float tf = 0.000;    //Low-pass filter 
float ramp = 100000;     //Limit how many volts per second the controller can increment
float sourceVoltage = 5.125;    //Voltage of the source
float limitV = 4.85;      //Limit the voltage, it is devided by two because of the way FOC works.

//Five Bar Parrallel Robot constants
const int l0 = 63;
const int l1 = 65;
const int l2 = 130;
const int l3 = 130;
const int l4 = 65;

//Angles calculated from the inverse kinematic model
float angleA, angleB;
float radA, radB;

//Circle DEMO angular positions for each motor [rad]
float circleA[] = {-0.3941,-0.4402,-0.4856,-0.5301,-0.5737,-0.616,-0.6569,-0.6963,-0.7337,-0.769,-0.8017,-0.8316,-0.858,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-0.3474,-0.3941};
float circleB[] = {-1.1362,-1.1087,-1.0798,-1.0492,-1.0171,-0.9832,-0.9475,-0.9099,-0.8703,-0.8286,-0.7848,-0.7386,-0.6901,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-1.1621,-1.1362};

//Four-points DEMO - Here is the best place to program your own sequences
float coinsA[] = {-1.5, 1, 1.6, 0.5};
float coinsB[] = {-1.1, 2, 0, -1};

//Array with fixed size for saved positions
static float posA[50];
static float posB[50];

//Target variable, works if virtual joystick is disabled
float target = 0;
int savedIndex = 0;
// loop stats variables
unsigned long t = 0;
long timestamp = micros();

//Declare functions that are written below before void setup()
static void IRAM_ATTR setup_MCPWM();
void WebSocketEvent_vd(uint8_t num_u8s, WStype_t type_ws, uint8_t *payload_u8sp, size_t length);
void serialEvent();
void handleData();
void inverseKinemstics();
void printGains();

void setup() {
  Serial.begin(115200);
  setup_MCPWM();
  _delay(100);
  
  //  Quadrature::ENABLE - CPR = 4xPPR  - default
  encoder.quadrature = Quadrature::ENABLE;
  encoderB.quadrature = Quadrature::ENABLE;

  // Pullup::EXTERN - external pullup added - dafault
  // Pullup::INTERN - needs internal pullup
  encoder.pullup = Pullup::EXTERN;
  encoderB.pullup = Pullup::EXTERN;

  // initialise encoder hardware
  encoder.init();
  encoder.enableInterrupts(doA1,doB1);
  encoderB.init();
  encoderB.enableInterrupts(doA2,doB2);
  
  // power supply voltage, default 12V
  motor.voltage_power_supply = sourceVoltage;
  motorB.voltage_power_supply = sourceVoltage;

  // sellect FOC loop to be used
  // ControlType::voltage
  // ControlType::velocity
  // ControlType::angle
  motor.controller = ControlType::angle;
  motorB.controller = ControlType::angle;
  
  // velocity PI controller parameters
  motor.PI_velocity.P = ki;                         // default K=1.0 Ti = 0.003
  motor.PI_velocity.I = ti;
  motor.PI_velocity.voltage_limit = limitV;         //defualt voltage_power_supply
  // jerk control using voltage voltage ramp
  motor.PI_velocity.voltage_ramp = ramp;            // default value is 300 volts per sec  ~ 0.3V per millisecond
  // velocity low pass filtering
  motor.LPF_velocity.Tf = tf;                       // default 10ms 

  // velocity PI controller parameters
  motorB.PI_velocity.P = ki;                        // default K=1.0 Ti = 0.003
  motorB.PI_velocity.I = ti;
  motorB.PI_velocity.voltage_limit = limitV;        //defualt voltage_power_supply/2
  // jerk control using voltage voltage ramp
  motorB.PI_velocity.voltage_ramp = ramp;           // default value is 300 volts per sec  ~ 0.3V per millisecond
  // velocity low pass filtering
  motorB.LPF_velocity.Tf = tf;                      // default 10ms
  
  // angle P controller 
  motor.P_angle.P = kp;                             // default K=70
  // maximal velocity of the poisiiton control
  motor.P_angle.velocity_limit = 200000;            // default 20

  // angle P controller 
  motorB.P_angle.P = kp;                            // default K=70
  //  maximal velocity of the poisiiton control
  motorB.P_angle.velocity_limit = 200000;           // default 20

  // use debugging with serial for motor init
  //motor.useDebugging(Serial);

  // link the motor to the sensor
  motor.linkSensor(&encoder);
  motorB.linkSensor(&encoderB);

  // intialise motor
  // align encoder and start FOC
  motor.init();
  motor.initFOC();
  Serial.println("Motor A ready.");
  _delay(200);
  
  motorB.init();
  motorB.initFOC();
  Serial.println("Motor B ready.");
  _delay(200);
  
  Serial.println("JANUS Ready.");
  _delay(500);

  //Wifi initialization
  WiFi.mode(WIFI_STA);
  WiFi.begin(ssid_wifi, password_wifi);
  Serial.print("Conectando a:\t");
  Serial.println(ssid_wifi); 
  
  // Waits for connection to be established
  while (WiFi.status() != WL_CONNECTED){
    delay(200);
    Serial.print('.');
  }

  //Print server IP to virtual COM
  Serial.println(WiFi.localIP());

  server.on("/", []() {                              
      server.sendHeader("content-encoding","gzip");                             
      server.send_P(200, "text/html", INDEX_HTML,sizeof(INDEX_HTML));     
  });
  server.begin();                                   
  Serial.println("WebServer initiated...");  

  webSocket.begin();
  /*Event of the WebSocket*/
  webSocket.onEvent(WebSocketEvent_vd);

  //Print starting system gains, can be changed though the virtual COM
  printGains();
}

void loop() {
  // Manage INPUTs from the virtual COM
  serialEvent();
  
  // Iterative state calculation calculating angle and setting FOC pahse voltage
  // The faster you run this funciton the better, in arduino loop it should have ~1kHz, the best would be to be in ~10kHz range
  motor.loopFOC();
  motorB.loopFOC();

  // Check the angular position of the rotor each iteration
  radA = motor.shaft_angle;
  radB = motorB.shaft_angle;
  
  //Function intended to be used with serial plotter to monitor motor variables, significantly slowing the execution down!!!!
  //motor_monitor();

  // STATE MACHINE
  if (machineState == 0){   //Default, Robot control through wifi controller
    inverseKinematics(posX_joy, posY_joy);
    motor.move(angleA);
    motorB.move(angleB);
  }
  else if ( machineState == 3){   //Saved positions DEMO
     motor.move(posA[sp]);
     motorB.move(posB[sp]);
  }
  else if ( machineState == 6){   //Circle DEMO
    motor.move(circleA[sp]+0.6);
    motorB.move(circleB[sp]+0.6);
  }
  else if ( machineState == 7){   //Coins DEMO
    motor.move(coinsA[sp]);
    motorB.move(coinsB[sp]);
  }

  //Time managment for dinamic movement DEMOs
  runTime = micros();
  timeDif = runTime - prevT;  //How much time each loop takes
  prevT = runTime;
  stateT += timeDif;

  if(sp == limit){
    sp = 0 ;
  }
  
  if(stateT >= timeInterval && (machineState == 6 || machineState == 7 || machineState == 3 )){
    sp += 1;
    stateT = 0;
    //Serial.println(sp);
  }
  
  server.handleClient();
  webSocket.loop();                                       
  handleData();
}

//Inverse kinematic model. Accepts x and y positions [mm] from the virtual joystick and returns motors' angles [rad].
void inverseKinematics(int posX, int posY){
  if (posX == 0 && posY == 0){
    posX = 200;
    posY = 200;
  }
  
  posX = (posX - 200)*1.45;
  posY = 300 - posY;
  if (posY <= 0) posY = 0;
  
  float dA = sqrt((posY*posY)+(((l0/2)+posX)*((l0/2)+posX)));
  float argA = ((dA*dA)+(l1*l1)-(l2*l2))/(2*dA*l1);
  if (argA >= 1) argA = 1;
  else if (argA <= 0) argA = 0;
  float phiA = acos(argA);
  //if (posY >=50 || posX <= 0){
    float thetaA = atan2(posY,((l0/2)+posX));
    angleA = -((thetaA + phiA - 14*PI/15))+0.1;
  //}
  //else{
    //angleA = -((phiA - 14*PI/15))+0.1;
  //}

  
  float dB = sqrt((posY*posY)+(((l0/2)-posX)*((l0/2)-posX)));
  float argB = ((dB*dB)+(l4*l4)-(l3*l3))/(2*dB*l4);
  if (argB >= 1) argB = 1;
  else if (argB <= 0) argB = 0;
  float phiB = acos(argB);
  
  //if (posY >=50 || posX > 0){
    float thetaB = atan2(posY,((l0/2)-posX));
    angleB = ((thetaB + phiB - 14*PI/15))+0.35;
  //}
  //else{
    //angleB = ((phiB - 14*PI/15))+0.35;
  //}
   
  //Serial.print("posX: ");
  //Serial.print(posX);
  //Serial.print(", posY: ");
  //Serial.print(posY);
  //Serial.println(thetaA);
  //Serial.println(dA);
  //Serial.println(argA);
  //Serial.println(phiA);
  //Serial.print(", angleA: ");
  //Serial.print(angleA);
  //Serial.print(", angleB: ");
  //Serial.println(angleB);
}

//Function that manages each button input
void handleData(){
  if (coordenadas[0]!= posX_joy || coordenadas[1]!=posY_joy)
  {
    Serial.print("X:");
    Serial.print(coordenadas[0]);
    Serial.print("\t");
    Serial.print("Y:");
    Serial.println(coordenadas[1]);
  }
  if(coordenadas[2]==1 && save!=coordenadas[2]){
    Serial.println("Position saved");
    posA[savedIndex] = radA;
    posB[savedIndex] = radB;
    Serial.print("Motor A angle: ");
    Serial.println(posA[savedIndex]);
    Serial.print("Motor B angle: ");
    Serial.println(posB[savedIndex]);
    Serial.print("Saved Position Index: ");
    Serial.println(savedIndex);
    savedIndex += 1;
  }
  else if(coordenadas[3]==1 && play!=coordenadas[3] ){
    if(posA[0] == 0 && posB[0] == 0){
      Serial.println("No points saved.");
    }
    else{
      Serial.println("Play saved positions");
      timeInterval = 500000;
      limit = savedIndex;
      sp = 0;
      motor.P_angle.P = 25;
      motorB.P_angle.P = 25;
      machineState = 3;
    }
  }
  else if(coordenadas[4]==1 && stap!=coordenadas[4]){
    Serial.println("Stop");
    motor.P_angle.P = kp;
    motorB.P_angle.P = kp;
    machineState = 0;
  }
  else if(coordenadas[5]==1 && reset!=coordenadas[5]){
    Serial.println("Reset saved positions");
    savedIndex = 0;
    limit = 0;
    sp = 0;
    motor.P_angle.P = kp;
    motorB.P_angle.P = kp;
    machineState = 0;
    memset(posA, 0, sizeof(posA));
    memset(posB, 0, sizeof(posB));
  }
  else if(coordenadas[6]==1 && demoC!=coordenadas[6]){
    Serial.println("Circle DEMO");
    limit = 100;
    timeInterval = 15000;
    sp = 0;
    motor.P_angle.P = 25;
    motorB.P_angle.P = 25;
    machineState = 6;
  }
  else if(coordenadas[7]==1 && demoM!=coordenadas[7]){
    Serial.println("Coins DEMO");
    limit = 4;
    timeInterval = 500000;
    sp = 0;
    motor.P_angle.P = 25;
    motorB.P_angle.P = 25;
    machineState = 7;
  }
  
  posX_joy=coordenadas[0];
  posY_joy=coordenadas[1];
  save = coordenadas[2];
  play = coordenadas[3];
  stap = coordenadas[4];
  reset = coordenadas[5];
  demoC = coordenadas[6];
  demoM = coordenadas[7];
}


// Serial communication callback
void serialEvent() {
  // a string to hold incoming data
  static String inputString;
  while (Serial.available()) {
    // get the new byte:
    char inChar = (char)Serial.read();
    // add it to the inputString:
    inputString += inChar;
    // if the incoming character is a newline
    // end of input
    if (inChar == '\n') {
      if(inputString.charAt(0) == 'P'){
        motor.PI_velocity.P = inputString.substring(1).toFloat();
        motorB.PI_velocity.P = inputString.substring(1).toFloat();
        printGains();
      }else if(inputString.charAt(0) == 'I'){
        motor.PI_velocity.I = inputString.substring(1).toFloat();
        motorB.PI_velocity.I = inputString.substring(1).toFloat();
        printGains();
      }else if(inputString.charAt(0) == 'F'){
        motor.LPF_velocity.Tf = inputString.substring(1).toFloat();
        motorB.LPF_velocity.Tf = inputString.substring(1).toFloat();
        printGains();
      }else if(inputString.charAt(0) == 'K'){
        motor.P_angle.P = inputString.substring(1).toFloat();
        motorB.P_angle.P = inputString.substring(1).toFloat();
        printGains();
      }else if(inputString.charAt(0) == 'R'){
        motor.PI_velocity.voltage_ramp = inputString.substring(1).toFloat();
        motorB.PI_velocity.voltage_ramp = inputString.substring(1).toFloat();
        printGains();
      }else if(inputString.charAt(0) == 'L'){
        motor.PI_velocity.voltage_limit = inputString.substring(1).toFloat();
        motorB.PI_velocity.voltage_limit = inputString.substring(1).toFloat();
        printGains();
      }else if(inputString.charAt(0) == 'T'){
        Serial.print("Average loop time is (microseconds): ");
        Serial.println((micros() - timestamp)/t);
        t = 0;
        timestamp = micros();
      }else if(inputString.charAt(0) == 'C'){
        Serial.print("Contoller type: ");
        int cnt = inputString.substring(1).toFloat();
        if(cnt == 0){
          Serial.println("angle!");
          motor.controller = ControlType::angle;
        }else if(cnt == 1){
          Serial.println("velocity!");
          motor.controller = ControlType::velocity;
        }else if(cnt == 2){
          Serial.println("volatge!");
          motor.controller = ControlType::voltage;
        }
        Serial.println();
        t = 0;
        timestamp = micros();
      }else{
        target = inputString.toFloat();
        Serial.print("Target : ");
        Serial.println(target);
        inputString = "";
      }
      inputString = "";
    }
  }
}

//Function that prints the value of the system control gains.
void printGains(){
  Serial.print("PI velocity P: ");
  Serial.print(motor.PI_velocity.P);
  Serial.print(",\t I: ");
  Serial.print(motor.PI_velocity.I);
  Serial.print(",\t Low passs filter Tf: ");
  Serial.print(motor.LPF_velocity.Tf,4);
  Serial.print(",\t Kp angle: ");
  Serial.println(motor.P_angle.P);
  Serial.print("Voltage ramp: ");
  Serial.print(motor.PI_velocity.voltage_ramp);
  Serial.print(",\t Voltage limit: ");
  Serial.println(motor.PI_velocity.voltage_limit);
}

// Utility function intended to be used with serial plotter to monitor motor variables, significantly slowing the execution down!!!!
void motor_monitor() {
  switch (motor.controller) {
    case ControlType::velocity:
      Serial.print(motor.voltage_q);
      Serial.print("\t");
      Serial.print(motor.shaft_velocity_sp);
      Serial.print("\t");
      Serial.println(motor.shaft_velocity);
      break;
    case ControlType::angle:
      Serial.print(motor.voltage_q);
      Serial.print("\t");
      Serial.print(motor.shaft_angle_sp);
      Serial.print("\t");
      Serial.println(motor.shaft_angle);
      break;
    case ControlType::voltage:
      Serial.print(motor.voltage_q);
      Serial.print("\t");
      Serial.print(motor.shaft_angle);
      Serial.print("\t");
      Serial.println(motor.shaft_velocity);
      break;
  }
}

// Function that initializes the GPIOs that are going to be used for the PWM signals that drive the L293
static void setup_MCPWM_pins(){
    Serial.println("Initializing MCPWM control PINs...");
    mcpwm_gpio_init(MCPWM_UNIT_0, MCPWM0A, GPIO_PWM0A_OUT);
    mcpwm_gpio_init(MCPWM_UNIT_0, MCPWM0B, GPIO_PWM0B_OUT);
    mcpwm_gpio_init(MCPWM_UNIT_0, MCPWM1A, GPIO_PWM1A_OUT);
    mcpwm_gpio_init(MCPWM_UNIT_0, MCPWM1B, GPIO_PWM1B_OUT);
    mcpwm_gpio_init(MCPWM_UNIT_0, MCPWM2A, GPIO_PWM2A_OUT);
    mcpwm_gpio_init(MCPWM_UNIT_0, MCPWM2B, GPIO_PWM2B_OUT);
}

#define TIMER_CLK_PRESCALE 1
#define MCPWM_CLK_PRESCALE 0
#define MCPWM_PERIOD_PRESCALE 4
#define MCPWM_PERIOD_PERIOD 2048

static void IRAM_ATTR setup_MCPWM(){
     setup_MCPWM_pins();

     mcpwm_config_t pwm_config;
     pwm_config.frequency = 4000000;  //frequency = 20000Hz
     pwm_config.cmpr_a = 0;      //duty cycle of PWMxA = 50.0%
     pwm_config.cmpr_b = 0;      //duty cycle of PWMxB = 50.0%
     pwm_config.counter_mode = MCPWM_UP_DOWN_COUNTER; // Up-down counter (triangle wave)
     pwm_config.duty_mode = MCPWM_DUTY_MODE_0; // Active HIGH
     mcpwm_init(MCPWM_UNIT_0, MCPWM_TIMER_0, &pwm_config);    //Configure PWM0A & PWM0B with above settings
     mcpwm_init(MCPWM_UNIT_0, MCPWM_TIMER_1, &pwm_config);    //Configure PWM0A & PWM0B with above settings
     mcpwm_init(MCPWM_UNIT_0, MCPWM_TIMER_2, &pwm_config);    //Configure PWM0A & PWM0B with above settings

     mcpwm_stop(MCPWM_UNIT_0, MCPWM_TIMER_0);
     mcpwm_stop(MCPWM_UNIT_0, MCPWM_TIMER_1);
     mcpwm_stop(MCPWM_UNIT_0, MCPWM_TIMER_2);
     MCPWM0.clk_cfg.prescale = MCPWM_CLK_PRESCALE;
  
     MCPWM0.timer[0].period.prescale = MCPWM_PERIOD_PRESCALE;
     MCPWM0.timer[1].period.prescale = MCPWM_PERIOD_PRESCALE;
     MCPWM0.timer[2].period.prescale = MCPWM_PERIOD_PRESCALE;    
     delay(1);
     MCPWM0.timer[0].period.period = MCPWM_PERIOD_PERIOD;
     MCPWM0.timer[1].period.period = MCPWM_PERIOD_PERIOD;
     MCPWM0.timer[2].period.period = MCPWM_PERIOD_PERIOD;
     delay(1);
     MCPWM0.timer[0].period.upmethod =0;
     MCPWM0.timer[1].period.upmethod =0;
     MCPWM0.timer[2].period.upmethod =0;
     delay(1); 
     
     mcpwm_start(MCPWM_UNIT_0, MCPWM_TIMER_0);
     mcpwm_start(MCPWM_UNIT_0, MCPWM_TIMER_1);
     mcpwm_start(MCPWM_UNIT_0, MCPWM_TIMER_2);
   
     mcpwm_sync_enable(MCPWM_UNIT_0, MCPWM_TIMER_0, MCPWM_SELECT_SYNC_INT0, 0);
     mcpwm_sync_enable(MCPWM_UNIT_0, MCPWM_TIMER_1, MCPWM_SELECT_SYNC_INT0, 0);
     mcpwm_sync_enable(MCPWM_UNIT_0, MCPWM_TIMER_2, MCPWM_SELECT_SYNC_INT0, 0);
     delayMicroseconds(1000);
     MCPWM0.timer[0].sync.out_sel = 1;
     delayMicroseconds(1000);
     MCPWM0.timer[0].sync.out_sel = 0;

}

//Web sockets event handle. Transforms the values recieved from the webpage into an array.
void WebSocketEvent_vd(uint8_t num_u8s, WStype_t type_ws, uint8_t *payload_u8sp, size_t length) 
{
    switch(type_ws) 
    {
        /*When there is a new connection sends a string of "0"*/
        case WStype_CONNECTED: 
        {
          Serial.println("Client connected.");
        }
        break;
        /*When there is a new connection sends a string of "0"*/
        case WStype_DISCONNECTED:
        {
          Serial.println("Client disconnected.");
        }
        break;
        /*When there is new data available from the HTML*/
        case WStype_TEXT:
        {
            dataJoy = (char*)payload_u8sp;  
            char delimiter [] = " ";
            char* rest = strtok (dataJoy, delimiter);
            i=0; 
            while(rest != NULL) 
            {
              coordenadas[i]=atoi(rest);
              rest = strtok(NULL, delimiter);
              i++;
            }      
        }
        break;
        
        /*When there is an error in the WebSocket communication*/
        case WStype_ERROR:                                                                
        {
        }
        break;
    }
}
